#include "main.h"
#include "rtc.h"
#include <string.h>
#include "drv_wave1006.h"

#define OTP_LENGTH_SD3900           1024
uint8_t g_otpBuffer[OTP_LENGTH_SD3900] = {0xff};
#define CAP_STEP_2D4			23
#define CAP_STEP_1D2			126
#define CAP_STEP_0D8			191
#define CAP_STEP_0D6			284
#define CAP_STEP_0D4			SD8800_CAP_LIST_MAX

uint8_t g_capList[SD8800_CAP_LIST_MAX + 1][2] = {
	{0x10,0x00},
	{0x10,0x02},
	{0x10,0x03},
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	{0x17,0xff},

};


uint8_t rtc_read_temp(uint8_t* temp)
{
	uint8_t time = 20;
	uint8_t buffer = 0;


	if(rtc_write_lock_on() != I2C_OK)
		return I2C_NO_ACK;
	
    buffer = 0x10;
    if (rtc_write_multi_bytes(RTC_3900_ADDRESS, 0x17, &buffer, 1) != I2C_OK) 
		return I2C_NO_ACK;
	
	if(rtc_write_lock_off() != I2C_OK)
		return I2C_NO_ACK;
	
	while(time --)
	{
		HAL_Delay(1);
		
        rtc_read_multi_bytes(RTC_3900_ADDRESS, 0x17, &buffer, 1);
		if (!(buffer & 0x20)) {
            rtc_read_multi_bytes(RTC_3900_ADDRESS, 0x16, &buffer, 1);
            *temp = buffer;
            return I2C_OK;
        }
	}
	
	return I2C_NO_ACK;
}

uint8_t rtc_set_bat_charge(uint8_t mode)
{
	uint8_t buffer = 0;

	if(rtc_write_lock_on() != I2C_OK)
		return I2C_NO_ACK;
		
	if (mode == 0) { 
		buffer = 0x00; 
	} else {
		buffer = 0x82;
	}
    if (rtc_write_multi_bytes(RTC_3900_ADDRESS, 0x18, &buffer, 1) != I2C_OK) 
		return I2C_NO_ACK;
	
	if(rtc_write_lock_off() != I2C_OK)
		return I2C_NO_ACK;
	
	return I2C_OK;
}

float system_get_rtc_temp(void)//已改1208
{
	float tempSum = 0;
	uint8_t count = 0;
	uint16_t readTemp;
	int quick;
	int i;

	for (i = 0; i < 5; i++) {
		if (wave1006_read_temp_adc(&readTemp) > 0) {
			quick = readTemp;
			// if (quick > 160) {
			// 	quick =  quick - 256;
			// }
			count++;
			tempSum += quick;
		}
		HAL_Delay(5);
	}
	if (count == 0) {
		tempSum = -300;
	} else {
		tempSum = tempSum / count;
	}
	return tempSum;
}


uint8_t rtc_read_vbat(int* vbat)
{
	uint8_t time = 20;
	uint8_t buffer[2] = {0};
    int value = 0;
    *vbat = 0;

	if(rtc_write_lock_on() != I2C_OK)
		return I2C_NO_ACK;
	
    buffer[0] = 0x10;
    if (rtc_write_multi_bytes(RTC_3900_ADDRESS, 0x19, buffer, 1) != I2C_OK) 
		return I2C_NO_ACK;
	
	if(rtc_write_lock_off() != I2C_OK)
		return I2C_NO_ACK;
	
	while (time --)
	{
		HAL_Delay(1);
		
        rtc_read_multi_bytes(RTC_3900_ADDRESS, 0x17, buffer, 1);
		if (!(buffer[0] & 0x20)) {
            rtc_read_multi_bytes(RTC_3900_ADDRESS, 0x1A, buffer, 2);
            value = buffer[0] & 0x80;
            value = (value << 1) + buffer[1];
            *vbat = value;
            return I2C_OK;
        }
	}
	
	return I2C_NO_ACK;

}
uint8_t rtc_read_date(RealTime* psRTC)
{
    uint8_t buffer[7] = {0};
    
    if (rtc_read_multi_bytes(RTC_3900_ADDRESS, 0x00, buffer, 7)!= I2C_OK) {
        return I2C_NO_ACK;
    } 
    psRTC->sec = (buffer[0] / 16) * 10 + (buffer[0] % 16);
    psRTC->min = (buffer[1] / 16) * 10 + (buffer[1] % 16);
    if (buffer[2] & 0x80) {//
        buffer[2] = buffer[2] & 0x7f;
        psRTC->hour = (buffer[2] / 16) * 10 + (buffer[2] % 16);
    } else {
        if (buffer[2] & 0x20) {//
            buffer[2] = buffer[2] & 0x1f;
            psRTC->hour = (buffer[2] / 16) * 10 + (buffer[2] % 16) + 12;
        } else {//
            buffer[2] = buffer[2] & 0x1f;
            psRTC->hour = (buffer[2] / 16) * 10 + (buffer[2] % 16);
        }
    }
    // psRTC->week = (buffer[3] / 16) * 10 + (buffer[3] % 16);
    psRTC->day = (buffer[4] / 16) * 10 + (buffer[4] % 16);
    psRTC->mon = (buffer[5] / 16) * 10 + (buffer[5] % 16);
    psRTC->year = (buffer[6] / 16) * 10 + (buffer[6] % 16);
    return I2C_OK;
}

uint8_t rtc_write_date(RealTime* setRTC)	
{                               
    uint8_t buffer[7] = {0};
    rtc_write_lock_on();
    buffer[0] = (setRTC->sec / 10) * 16 + (setRTC->sec % 10);
    buffer[1] = (setRTC->min / 10) * 16 + (setRTC->min % 10);
    buffer[2] = (setRTC->hour / 10) * 16 + (setRTC->hour % 10) + 0x80;//
    buffer[3] = 0;
    buffer[4] = (setRTC->day / 10) * 16 + (setRTC->day % 10);
    buffer[5] = (setRTC->mon / 10) * 16 + (setRTC->mon % 10);
    buffer[6] = (setRTC->year / 10) * 16 + (setRTC->year % 10);
    if (rtc_write_multi_bytes(RTC_3900_ADDRESS, 0x00, buffer, 7)!= I2C_OK) {
        rtc_write_lock_off();
        return I2C_NO_ACK;
    } 
    rtc_write_lock_off();
    return I2C_OK;
}

void PrintfTime(RealTime* rtc)
{
	// UsbPrintf("\n20%d/%d/%d %d:%d:%d\n", rtc->year, rtc->mon, rtc->day, rtc->hour, rtc->min, rtc->sec);
}



uint8_t rtc_out_4096(void)
{
	uint8_t buffer[2] = {0xA1, 0x44};
	if (rtc_write_multi_bytes(RTC_3900_ADDRESS, 0x10, buffer, 2) != I2C_OK) {
		UsbPrintf("out 64Hz error!!\n");
        return I2C_NO_ACK;
    } 
	
	// UsbPrintf("out 64Hz ...\n");
	return I2C_OK;
}

uint8_t rtc_disable_int(void)
{
    uint8_t buffer[2] = {0x00, 0x40};
	uint8_t i;
	for (i = 0; i < 10; i++) {
		if (check_sda_level()) {
			if (rtc_write_multi_bytes(RTC_3900_ADDRESS, 0x10, buffer, 2) == I2C_OK) {
				// UsbPrintf("close 64Hz ...\n");
				return I2C_OK;
			}
		}
		HAL_Delay(2);
	}
	UsbPrintf("close int error\n");
	return I2C_NO_ACK;
}


uint8_t rtc_set_testcap(uint8_t *p_dat)
{	
	uint8_t i;
	for (i = 0; i < 10; i++) {
		if (check_sda_level()) {
			if (rtc_write_multi_bytes(RTC_3900_ADDRESS, WAVE1006_REG_USER_RAM_START + 21, p_dat, 2) == I2C_OK) {
				return I2C_OK;
			} 
		}
		HAL_Delay(2);
	}
	UsbPrintf("adjust cap iic error\n");
	return I2C_NO_ACK;
}

uint8_t rtc_set_testmode(void)
{
	// uint8_t config[9] = {0xFF, 0xFF, 0x2F, 0xFF, 0x30, 0x30, 0xFE, 0x22, 0x80};
		
    // rtc_write_lock_on();
	
	// if (rtc_write_multi_bytes(RTC_3900_ADDRESS, 0x3F, config, 9)!= I2C_OK) {
    //     rtc_write_lock_off();
    //     return I2C_NO_ACK;
    // } 
    // rtc_write_lock_off();
	return I2C_OK;
}

uint8_t rtc_1006_set_testmode(uint8_t channel)
{
	uint8_t buf;
	uint8_t osc_buf[2] = {0};

	rtc_set_channel(channel, RTC_INIT_1006);
	buf = 0x40;
	if(drv_wave1006_write_reg(DEV_SD8804, WAVE1006_REG_CTR3, 1, &buf) != WAVE1006_EXIT_OK)   //如果是有应该先关闭32K输出(默认为关闭SD3068的32K)
	{
		return I2C_NO_ACK;
	}

	//选择为SD3078B封装(必须在进测试模式之前选择，否则芯片pad改变)
	if (drv_wave1006_read_reg(DEV_SD3068, WAVE1006_REG_USER_RAM_START + 20, 1, &buf) != WAVE1006_EXIT_OK)   //回读ram21
	{
		return I2C_NO_ACK;
	}
	buf &= ~0x0f;
	buf |= 0x0d;
	if (drv_wave1006_write_reg(DEV_SD3068, WAVE1006_REG_USER_RAM_START + 20, 1, &buf) != WAVE1006_EXIT_OK)//写入部分ram21寄存器
	{
		return I2C_NO_ACK;
	}
	if (wave1006_enter_test_mode(WAVE1006_TEST_PAD | WAVE1006_TEST_OSC | WAVE1006_TEST_ADC) != WAVE1006_EXIT_OK)   //此处一定要注意，没进入测试模式也需要将I0切换掉，或者不能继续运行程序
	{
		return I2C_NO_ACK;
	}
	// UsbPrintf("pad change OK\n");
	HAL_Delay(5);
	rtc_set_channel(channel, RTC_SD3068);
	if (drv_wave1006_read_reg(DEV_SD3068, WAVE1006_REG_USER_RAM_START + 19, 1, &buf) != WAVE1006_EXIT_OK) 
	{
		return I2C_NO_ACK;
	}
	buf &= ~0x38;   //清0 RuleTempAdj[2:0]      //ADC尺子 暂选5
	buf |=  0x28;
	if (drv_wave1006_write_reg(DEV_SD3068, WAVE1006_REG_USER_RAM_START + 19, 1, &buf) != WAVE1006_EXIT_OK)
	{
		return I2C_NO_ACK;
	}

	//1、配置好OSC TEST参数     RAM24、RAM25
	if (drv_wave1006_read_reg(DEV_SD8804, WAVE1006_REG_USER_RAM_START + 24, 1, &osc_buf[1]) != WAVE1006_EXIT_OK)  //读ram25   
	{
		return I2C_NO_ACK;
	}
	osc_buf[0]  = 0xf7;   //ram24
	osc_buf[1] &= ~0x1f;
	osc_buf[1] |= 0x19;		//ram25
	if (drv_wave1006_write_reg(DEV_SD8804, WAVE1006_REG_USER_RAM_START + 23, 2, osc_buf) != WAVE1006_EXIT_OK)    //写ram24、ram25
	{
		return I2C_NO_ACK;
	}
	UsbPrintf("i2c OK after pad change \n");
	
	return I2C_OK;
}

uint8_t rtc_1006_exit_testmode(uint8_t channel)
{
	uint8_t buf = 0x00;
		
	buf = 0x00;
	if (rtc_write_multi_bytes(RTC_3900_ADDRESS, WAVE1006_REG_EXTEND , &buf, 1) != I2C_OK) {
		rtc_set_channel(channel, RTC_INIT_1006);
		UsbPrintf("warning! RTC exit testmode fail!\n");
		return I2C_NO_ACK;
	} 
	rtc_set_channel(channel, RTC_INIT_1006);
	UsbPrintf("exit testmode success\n");
	return I2C_OK;
}


void rtc_set_int_channel(uint8_t channel)
{
    // uint8_t intChannel;
    // HAL_GPIO_WritePin(GPIOC, GPIO_PIN_1 | GPIO_PIN_3 | GPIO_PIN_5 | GPIO_PIN_7 | 
	// 						GPIO_PIN_9| GPIO_PIN_11, GPIO_PIN_SET);
    // intChannel = (channel - 1) / 14;
    // HAL_GPIO_WritePin(GPIOE, GPIO_PIN_0, intChannel & 0x01);
    // HAL_GPIO_WritePin(GPIOE, GPIO_PIN_1, intChannel & 0x02);
    // HAL_GPIO_WritePin(GPIOE, GPIO_PIN_2, intChannel & 0x04);
    // HAL_GPIO_WritePin(GPIOE, GPIO_PIN_3, GPIO_PIN_RESET);
}


uint8_t rtc_convert_temp_offset(float rtc_adc, float system_temp)
{
	uint8_t offset;
	offset = (uint8_t)(((rtc_adc - (system_temp + 60) * 2)) * 2 - 48);//详见芯片设计手册，起始-60度，地址为0x30;每1bitADC，对应2位otp；每1℃对应2bitADC；
	return offset;
}

uint8_t rtc_write_otp_config(void)
{
    uint8_t config[16]=	{0xBC, 0xEB, 0xFF, 0xFF, 0x2F, 0xFF, 0xFF, 0xFE, 0x22, 0xFF, 0x00, 0x00, 0xFF, 0x02, 0xDC, 0x4A};
    // uint8_t config[16]=	{0xBC, 0xEF, 0xFF, 0xFF, 0x2F, 0xFF, 0xFF, 0xFE, 0x22, 0xFF, 0x00, 0x00, 0xFF, 0x02, 0xDC, 0x4A};
    uint8_t i2c_result;
    i2c_result = rtc_download_otp_data(config, 0x162, 16);//0x162 is config0 address
    return i2c_result;
} 


uint16_t rtc_init_test_cap(float temp)
{
	uint16_t cap = 960;
	if (temp > -45 && temp <= -35)		//-40
	{
		cap = 360;
	}
	else if (temp > -15 && temp <= -5)	//-10
	{
		cap = 560;
	}
	else if (temp > 10 && temp <= 35)		//29
	{
		cap = 660;
	}
	else if (temp > 55 && temp <= 65)		//60
	{
		cap = 560;
	}
	else if (temp > 80 && temp <= 90)		//85
	{
		cap = 360;
	}
	return cap;
}
/*
OSCCapSel<12:11>	"振荡器引脚OSCIN和OSCOUT粗调电容选择项。
00:0pF
01:1.5pF
10:3.0pF
11:4.5pF"	
OSCCapSel<10:6>	"振荡器引脚OSCIN和OSCOUT次级粗调电容选择项。步进为408fF"
OSCCapSel<5:3>	"振荡器引脚OSCIN细调电容选择项。步进为51fF"
OSCCapSel<2:0>	"振荡器引脚OSCOUT细调电容选择项。步进为51fF"	
*/
float cap_uint_to_float(uint8_t cap1, uint8_t cap2)
{
	float convert = 0;
	uint16_t cap_config = 0;
	cap_config = ((cap2 & 0x07) << 5) | (cap1 >> 3);
	convert = 1.5 * ((cap2 >> 3) & 0x03) + cap_config * 0.051;
	return convert;
}

float cap_config_to_float(uint8_t mode, uint8_t cap)
{
	float convert = 0;
	convert = 1.5 * mode + cap * 0.051;
	return convert;
}

void cap_config_to_uint(uint8_t mode, uint8_t cap, uint8_t* cap_buf)
{
	cap_buf[0] = ((cap & 0xff) << 3) | (cap & 0x07);
	cap_buf[1] = ((mode & 0x03) << 3) | ((cap & 0xff) >> 5);
}

void cap_list_to_uint(uint16_t number, uint8_t* cap_buf)
{
	if (number < SD8800_CAP_LIST_MAX) {
		cap_buf[1] = g_capList[number][0];
		cap_buf[0] = g_capList[number][1];
	}
}

void cap_float_to_uint(float f_cap, uint8_t *p_dat1, uint8_t *p_dat2)
{
	float convert;
	uint16_t cap_config = 0;
	convert = f_cap - SD8800_CAP_MIN;//固定大电容
	cap_config = convert / 0.051;//矩阵小电容

	// if (cap_config > 0 && (cap_config + 1) % 32 == 0) {
	// 	cap_config -= 1;
	// } 
	*p_dat2 = (SD8800_CAP_MODE << 3) | ((cap_config & 0xff) >> 5);
	*p_dat1 = ((cap_config & 0xff) << 3) | (cap_config & 0x07);

}
uint16_t cap_list_number_convert(uint16_t start, float ppm)
{
	float sum2d4 = 2.4 * CAP_STEP_2D4;
	float sum1d2 = 1.2 * (CAP_STEP_1D2 - CAP_STEP_2D4);
	float sum0d8 = 0.8 * (CAP_STEP_0D8 - CAP_STEP_1D2);
	float sum0d6 = 0.6 * (CAP_STEP_0D6 - CAP_STEP_0D8);
	float sum0d4 = 0.4 * (start - CAP_STEP_0D6);
	uint16_t number = 1;
	if (ppm < sum0d4) {
		number = start - ppm * 2.5;
	} else {
		ppm -= sum0d4;
		if (ppm < sum0d6) {
			number = CAP_STEP_0D6 - ppm / 0.6;
		} else {
			ppm -= sum0d6;
			if (ppm < sum0d8) {
				number = CAP_STEP_0D8 - ppm / 0.8;
			} else {
				ppm -= sum0d8;
				if (ppm < sum1d2) {
					number = CAP_STEP_1D2 - ppm / 1.2;
				} else {
					ppm -= sum1d2;
					if (ppm < sum2d4) {
						number = CAP_STEP_2D4 - ppm / 2.4;
					} else {
						number = 1;
					}
				}
			}
		}
	}
	return number;
}

int digtal_adj_convert(uint16_t start, float ppm)
{
	float sum;
	int digtal = 0;
	
	sum = 2.4 * (CAP_STEP_2D4 - 1) + 1.2 * (CAP_STEP_1D2 - CAP_STEP_2D4) + 0.8 * (CAP_STEP_0D8 - CAP_STEP_1D2)
			+ 0.6 * (CAP_STEP_0D6 - CAP_STEP_0D8) + 0.4 * (start - CAP_STEP_0D6);
	if (ppm < sum) {
		return 0;
	} else {
		digtal = sum - ppm;
		if (digtal < -189) {//数字补偿只有6bit，最大值为63，对应的数为-189
			digtal = -189;
		}
		return digtal;
	}
}

uint8_t wave1006_read_temp_adc(uint16_t* temp)
{
	uint8_t buffer[2] = {0};
	buffer[0] = 0x10;
	uint8_t i;
	if (drv_wave1006_write_reg(DEV_SD3068, 0x17, 1, &buffer[0]) != WAVE1006_EXIT_OK) {
		return 0;
	}
	for (i = 0; i < 10; i++) {
		HAL_Delay(1);
		drv_wave1006_read_reg(DEV_SD3068, 0x17, 1, buffer);
		if ((buffer[0] & 0x30) == 0) {
			break;
		}
	}
	if (i >= 10) {return 0;}
	if (drv_wave1006_read_reg(DEV_SD3068, WAVE1006_REG_USER_RAM_START + 26, 2, buffer) != WAVE1006_EXIT_OK)  //读ram26、ram27  
	{
		return 0;
	}
	*temp = buffer[0];
	if (buffer[1] & 0x40) {
		*temp += 256;
	}
	return 1;
}
